## LKM-Source/Kconfig
```kconfig
menu "ReKernel-X"

config REKERNEL_X
	bool "ReKernel-X module"
	depends on MODULES
	default n
	help
	  Make tombstone users get a better experience.
	  Tips: Enabling this will build ReKernel-X as a module
endmenu
```
